## web_server/cpp_asio/main/Kconfig.projbuild
```kconfig
menu "Example Configuration"

    config EXAMPLE_PORT
        string "Asio example port number"
        default "80"
        help
            Port number used by Asio example.

endmenu
```

## web_server/rust/sdkconfig.defaults
```kconfig
CONFIG_LWIP_MAX_SOCKETS=200
CONFIG_LWIP_MAX_ACTIVE_TCP=200
CONFIG_LWIP_MAX_LISTENING_TCP=200
```
